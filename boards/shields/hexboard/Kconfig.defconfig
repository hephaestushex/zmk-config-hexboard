## boards/shields/hexboard/Kconfig.defconfig
```kconfig
if SHIELD_HEXBOARD_LEFT

# Name must be less than 16 characters long!
config ZMK_KEYBOARD_NAME
    default "HexBoard"

config ZMK_SPLIT_ROLE_CENTRAL
    default y

endif

if SHIELD_HEXBOARD_LEFT || SHIELD_HEXBOARD_RIGHT

config ZMK_SPLIT
    default y

endif
```

## boards/shields/hexboard/Kconfig.shield
```kconfig
config SHIELD_HEXBOARD_LEFT
    def_bool $(shields_list_contains,hexboard_left)

config SHIELD_HEXBOARD_RIGHT
    def_bool $(shields_list_contains,hexboard_right)
```
